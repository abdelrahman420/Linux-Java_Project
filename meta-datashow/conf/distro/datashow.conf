## meta-datashow/conf/distro/datashow.conf
```bitbake
include meta-poky/conf/distro/poky.conf 
# require conf/distro/poky
DISTRO = "datshow"
DISTRO_NAME = "datashow"
#DISTRO_VERSION = "3.4+snapshot-${METADATA_REVISION}"
DISTRO_VERSION = "4.0.20"
DISTRO_CODENAME = "kirkstone"

CONF_VERSION = "2"
DISTRO_FEATURES:append = " systemd x11 wayland opengl gtk3 gnome dbus"
VIRTUAL-RUNTIME_init_manager = "systemd"
VIRTUAL-RUNTIME_initscripts = "systemd-compat-units"
DISTRO_FEATURES_BACKFILL_CONSIDERD  += "sysvinit"

IMAGE_INSTALL:append = " dropbear systemd systemd-serialgetty  "

IMAGE_FSTYPES = "tar.xz ext3 rpi-sdimg" 
INHERIT = "rm_work" 
ENABLE_UART = "1"

MAINTAINER = "abdelrahmanmostafa532@gmail.com"

PREFERRED_VERSION_linux-yocto = "5.15%"
```

## meta-presenter/conf/layer.conf
```bitbake
# We have a conf and classes directory, add to BBPATH
BBPATH .= ":${LAYERDIR}"

# We have recipes-* directories, add to BBFILES
BBFILES += "${LAYERDIR}/recipes-*/*/*.bb \
            ${LAYERDIR}/recipes-*/*/*.bbappend"

BBFILE_COLLECTIONS += "meta-presenter"
BBFILE_PATTERN_meta-presenter = "^${LAYERDIR}/"
BBFILE_PRIORITY_meta-presenter = "6"

LAYERDEPENDS_meta-presenter = "core"
LAYERSERIES_COMPAT_meta-presenter = "kirkstone"
```
